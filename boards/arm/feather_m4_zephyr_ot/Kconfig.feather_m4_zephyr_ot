## boards/arm/feather_m4_zephyr_ot/Kconfig.feather_m4_zephyr_ot
```kconfig
# Copyright (c) 2024 Daikin Comfort Technologies North America, Inc.
# SPDX-License-Identifier: Apache-2.0

config BOARD_FEATHER_M4_ZEPHYR_OT
	select SOC_SAMD51J19A
```

## boards/arm/feather_m4_zephyr_ot/board.yml
```yaml
board:
  name: feather_m4_zephyr_ot
  full_name: Feather M4 Zephyr Out of Tree Board
  vendor: adafruit
  socs:
    - name: samd51j19a
```

## boards/arm/samd21_iot_wg/board.yml
```yaml
board:
  name: samd21_iot_wg
  full_name: SAM D21 IoT WG
  vendor: atmel
  socs:
    - name: samd21g18a
```

## boards/arm/samd21_iot_wg/samd21_iot_wg_defconfig
```kconfig
# Copyright (c) 2018 Bryan O'Donoghue
# Copyright (c) 2024 Gerson Fernando Budke <nandojve@gmail.com>
# SPDX-License-Identifier: Apache-2.0

# SAMD21_IOT_WG board does not have external oscillator
# Configure to use the internal 32kHz oscillator and also use that as main 
# Zephyr will take into account HW cycles requested and use DFPLL
CONFIG_SOC_ATMEL_SAMD_OSC32K=y 
CONFIG_SOC_ATMEL_SAMD_OSC32K_AS_MAIN=y 

CONFIG_SYS_CLOCK_HW_CYCLES_PER_SEC=48000000

CONFIG_PM=n 
CONFIG_WATCHDOG=n 

CONFIG_BUILD_OUTPUT_HEX=y

CONFIG_CONSOLE=y 
CONFIG_SERIAL=y 
CONFIG_UART_CONSOLE=y 
CONFIG_UART_INTERRUPT_DRIVEN=y 
```

## boards/arm/samd21_iot_wg2/board.yml
```yaml
board:
  name: samd21_iot_wg2
  full_name: SAM D21 IoT WG2
  vendor: atmel
  socs:
    - name: samd21g18a
```

## boards/arm/samd21_xpro_ot/board.yml
```yaml
board:
  name: samd21_xpro_ot
  full_name: SAM D21 Xplained Pro Out of Tree Board
  vendor: atmel
  socs:
    - name: samd21j18a
```

## boards/arm/samd21_xpro_ot/samd21_xpro_ot_defconfig
```kconfig
# Copyright (c) 2018 Bryan O'Donoghue
# Copyright (c) 2024 Gerson Fernando Budke <nandojve@gmail.com>
# SPDX-License-Identifier: Apache-2.0

CONFIG_SOC_ATMEL_SAMD_XOSC32K=y
CONFIG_SOC_ATMEL_SAMD_XOSC32K_AS_MAIN=y

CONFIG_SYS_CLOCK_HW_CYCLES_PER_SEC=48000000

CONFIG_BUILD_OUTPUT_HEX=y

CONFIG_CONSOLE=y
CONFIG_SERIAL=y
CONFIG_UART_CONSOLE=y
CONFIG_UART_INTERRUPT_DRIVEN=y
```

## mchp_hw_test/modules/ws2812_common/Kconfig
```kconfig
menu "WS2812 Common"

config WS2812_COMMON
    bool "WS2812 common library"
    default y

endmenu    
```
