## CMakeLists.txt
```
cmake_minimum_required(VERSION 3.20.0)

# ------------------------------------------------------------
# Board-specific DTS overlays (MUST be set before Zephyr)
# ------------------------------------------------------------
if(DEFINED BOARD)
  if(BOARD STREQUAL "same54_xpro")
    list(APPEND DTC_OVERLAY_FILE
      ${CMAKE_CURRENT_SOURCE_DIR}/boards/overlays/same54_xpro.overlay
    )
  elseif(BOARD STREQUAL "samd21_iot_wg")
    list(APPEND DTC_OVERLAY_FILE
      ${CMAKE_CURRENT_SOURCE_DIR}/boards/overlays/samd21_iot_wg.overlay
    )
  elseif(BOARD STREQUAL "samd21_iot_wg2")
    list(APPEND DTC_OVERLAY_FILE
      ${CMAKE_CURRENT_SOURCE_DIR}/boards/overlays/samd21_iot_wg2.overlay
    )
  elseif(BOARD STREQUAL "samd21_xpro_ot")
    list(APPEND DTC_OVERLAY_FILE
      ${CMAKE_CURRENT_SOURCE_DIR}/boards/overlays/samd21_xpro_ot.overlay
    )
  elseif(BOARD STREQUAL "feather_m4_zephyr_ot")
    list(APPEND DTC_OVERLAY_FILE
      ${CMAKE_CURRENT_SOURCE_DIR}/boards/overlays/feather_m4_zephyr_ot.overlay
    )
  endif()
endif()

list(APPEND ZEPHYR_EXTRA_MODULES
  ${CMAKE_CURRENT_LIST_DIR}/modules/ws2812_common
)

find_package(Zephyr REQUIRED HINTS $ENV{ZEPHYR_BASE})
project(mchp_hw_test)

target_include_directories(app PRIVATE ${CMAKE_CURRENT_LIST_DIR}/include)

target_sources(app PRIVATE
    src/main.c
    src/img_util.c
)

target_link_libraries(app PRIVATE ws2812_common)
```

## prj.conf
```kconfig
# Basic hardware test project config
# All major functionality to be tested is now in the feather_m4_zephyr_ot_defconfig file
```

## src/main.c
```c
/*
 * Main application for testing hw features of Zephyr handheld platform
 *
 */
#include <zephyr/kernel.h>
#include <zephyr/sys/printk.h>
#include <zephyr/drivers/gpio.h>
#include <zephyr/input/input.h>
#include <zephyr/device.h>
#include <zephyr/drivers/display.h>
#include <zephyr/storage/disk_access.h>
#include <ff.h>
#include <diskio.h>
#include <lvgl.h>
#include <ws2812_common.h>
#include "img_util.h"

static const struct gpio_dt_spec led = GPIO_DT_SPEC_GET(DT_ALIAS(led0), gpios);
static const struct gpio_dt_spec switch0 = GPIO_DT_SPEC_GET(DT_ALIAS(sw0), gpios);
static const struct gpio_dt_spec switch1 = GPIO_DT_SPEC_GET(DT_ALIAS(sw1), gpios);
volatile bool switch0_event = false;
volatile bool switch1_event = false;

typedef struct {
    const char *disk_name;
} fat_disk_t;

#define SLEEP_TIME_MS 20  /* Main loop sleep time */

static FATFS fat_fs;

#define NUM_LEDS 3
#define MAX_BRIGHTNESS 64
#define FADE_STEP 4
static int pos = 0;
static uint8_t brightness = MAX_BRIGHTNESS;

/* render to hardware */
static void render(void)
{
    /* set active LED to blue level */
    switch (pos) {
        case 0:
            ws2812_set_pixel(0, 0, 0, 0, brightness);  
            ws2812_set_pixel(1, 0, 0, 0, 0);  
            ws2812_set_pixel(1, 1, 0, 0, 0);  
            break;
        case 1:
            ws2812_set_pixel(0, 0, 0, 0, 0);  
            ws2812_set_pixel(1, 0, 0, 0, brightness); 
            ws2812_set_pixel(1, 1, 0, 0, 0);  
            break;
        case 2:
            ws2812_set_pixel(0, 0, 0, 0, 0);
            ws2812_set_pixel(1, 0, 0, 0, 0);  
            ws2812_set_pixel(1, 1,0, 0, brightness); 
            break;
    }

    ws2812_update(0);
    ws2812_update(1);
}

/* animation step */
static void step(void)
{
    render();

    /* fade down */
    if (brightness > FADE_STEP) {
        brightness -= FADE_STEP;
    } else {
        /* move to next LED */
        brightness = MAX_BRIGHTNESS;
        pos = (pos + 1) % NUM_LEDS;
    }
}

/* timer */
static void timer_handler(struct k_timer *dummy)
{
    step();
}

K_TIMER_DEFINE(anim_timer, timer_handler, NULL);

static void button_input_cb(struct input_event *evt, void *user_data)
{
    if (evt->sync == 0) {
        return;
    }

    if ((evt->code == INPUT_KEY_1) && (evt->value == 1)) {
        switch0_event = true;
    } else if ((evt->code == INPUT_KEY_2) && (evt->value == 1)) {
        switch1_event = true;
    }

    printk("Button %d %s\n", evt->code, evt->value ? "pressed" : "released");
}

INPUT_CALLBACK_DEFINE(NULL, button_input_cb, NULL);

void display_splash_screen(const struct device *display_dev)
{
    lv_obj_t *scr = lv_scr_act();
    lv_obj_set_style_bg_color(scr, lv_color_white(), LV_PART_MAIN); // Make it black
    lv_refr_now(NULL);  // Force immediate refresh to show white background before loading image

    display_bin_image(display_dev, "0:/mchplogo.bin", 8, 15);
    k_msleep(3000);  // Show splash screen for 3 seconds
}

int main(void)
{
    int ret;

    printk("Application started\n");

    /* Initialize LED GPIO */
    if (!gpio_is_ready_dt(&led)) {
        return 0;
    }

    ret = gpio_pin_configure_dt(&led, GPIO_OUTPUT_ACTIVE);
    if (ret < 0) {
        return 0;
    }

    // enable button interrupts
    if (device_is_ready(switch0.port)) {
        gpio_pin_interrupt_configure_dt(&switch0, GPIO_INPUT);  
    }
 
    if (device_is_ready(switch1.port)) {
        gpio_pin_interrupt_configure_dt(&switch1, GPIO_INPUT);  
    }   

    /* Set the intial colors of the WS2812 LED strips */
    ws2812_init();
    ws2812_set_pixel(0, 0, 64, 0, 0);  /* Set first LED of strip 0 to red */
    ws2812_update(0); 
    ws2812_set_pixel(1, 0, 0, 64, 0);  /* Set first LED of strip 1 to green */
    ws2812_set_pixel(1, 1, 0, 0, 64);  /* Set second LED of strip 1 to blue */
    ws2812_update(1);

    /* Initialize display and LVGL */
    const struct device *display_dev;

    display_dev = DEVICE_DT_GET(DT_CHOSEN(zephyr_display));
    if (!device_is_ready(display_dev)) {
        printk("Device not ready, aborting test\n");
        return 0;
    }

    display_set_pixel_format(display_dev, PIXEL_FORMAT_RGB_565);
    display_blanking_off(display_dev);

    /* Small delay to allow card to power up reliably */
    k_msleep(100);
    printk("SD card ready, mounting FatFS...\n");

    FRESULT fr = f_mount(&fat_fs, "0:", 1);  // "0:" is logical drive for FatFS
    if (fr == FR_OK) {
        printk("FATFS mounted\n");
        display_splash_screen(display_dev);
    } else {
        printk("f_mount failed: %d\n", fr);
        return 0;
    }

    /* ======== LVGL Screen Initialization ======== */
    lv_obj_set_style_bg_color(lv_screen_active(), lv_color_white(), LV_PART_MAIN);

    /* Temporary welcome label */
    lv_obj_t *label = lv_label_create(lv_screen_active());
    lv_label_set_text(label, "Zephyr Basic Test");
    lv_obj_center(label);

    k_timer_start(&anim_timer, K_MSEC(60), K_MSEC(60));

    /* Main application loop */
    while (1) {
        ret = gpio_pin_toggle_dt(&led);

        if (switch0_event) {
            lv_obj_set_style_bg_color(lv_screen_active(), lv_color_white(), LV_PART_MAIN);
            lv_refr_now(NULL);  // Force immediate refresh to show white background before loading image
            if (display_bin_image(display_dev, "0:/zlogo2.bin", 4, 59) == -1) {
                lv_label_set_text(label, "Failed to load image");
            }          
            switch0_event = false;
        }

        if (switch1_event) {
            lv_obj_set_style_bg_color(lv_screen_active(), lv_color_white(), LV_PART_MAIN);
            lv_refr_now(NULL);  // Force immediate refresh to show white background before loading image
            if (display_bin_image(display_dev, "0:/mchplogo.bin", 8, 15) == -1) {
                lv_label_set_text(label, "Failed to load image");
            }   
            switch1_event = false;
        }

        /* Run LVGL timer handler for UI updates */
        lv_timer_handler();

        k_msleep(SLEEP_TIME_MS);
    }

    return 0;
}
```

## include/img_util.h
```c
/*
 * Image utilities header
 */
#ifndef IMG_UTIL_H
#define IMG_UTIL_H

#include <zephyr/device.h>

/**
 * @brief Display a binary image file on the screen
 *
 * @param display Display device
 * @param path Path to the .bin image file (4-byte header: width, height as uint16_t)
 * @param x0 X position on display
 * @param y0 Y position on display
 * @return 0 on success, negative on error
 */
int display_bin_image(const struct device *display,
                      const char *path,
                      int x0, int y0);

#endif /* IMG_UTIL_H */
```

## src/img_util.c
```c
#include <zephyr/kernel.h>
#include <zephyr/device.h>
#include <zephyr/drivers/display.h>
#include <ff.h>
#include <string.h>

#define LINE_BUF_MAX 240  // adjust to your max width

static __aligned(4) uint16_t line_buf[LINE_BUF_MAX];

int display_bin_image(const struct device *display,
                      const char *path,
                      int x0, int y0)
{
    FIL file;
    UINT br;

    uint16_t width, height;
    uint16_t v;

    /* Open file */
    if (f_open(&file, path, FA_READ) != FR_OK) {
        printk("Failed to open %s\n", path);
        return -1;
    }

    /* Read header */
    f_read(&file, &width, 2, &br);
    f_read(&file, &height, 2, &br);

    if (width > LINE_BUF_MAX) {
        printk("Width too large\n");
        f_close(&file);
        return -1;
    }

    struct display_buffer_descriptor desc = {
        .width = width,
        .height = 1,
        .pitch = width,
        .buf_size = width * 2,
    };

    /* Stream each row */
    for (int y = 0; y < height; y++) {

        f_read(&file, line_buf, width * 2, &br);
        if (br != width * 2) {
            printk("Read error at line %d\n", y);
            break;
        }

        for(int i = 0; i < width; i++) {
            v = line_buf[i];
            line_buf[i] = (v >> 8) | (v << 8);  // Swap bytes for little-endian display
        }

        /* Write one line to display */
        display_write(display,
                      x0,
                      y0 + y,
                      &desc,
                      line_buf);
    }

    f_close(&file);

    return 0;
}
```
